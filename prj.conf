## CMakeLists.txt
```
#
# Copyright (C) 2023 Renesas Electronics Corporation.
# Copyright (C) 2023 EPAM Systems, Inc.
#
# SPDX-License-Identifier: Apache-2.0
#

cmake_minimum_required(VERSION 3.13.1)

find_package(Zephyr REQUIRED HINTS $ENV{ZEPHYR_BASE})

include($ENV{ZEPHYR_BASE}/cmake/app/boilerplate.cmake NO_POLICY_SCOPE)

project(aoszephyrapp)

# ######################################################################################################################
# Includes
# ######################################################################################################################

zephyr_include_directories(${CMAKE_CURRENT_BINARY_DIR} src)
# Add prebuilt to includes so assembler can find this files
include_directories(app PRIVATE ${CMAKE_CURRENT_SOURCE_DIR}/prebuilt)

# ######################################################################################################################
# Taget
# ######################################################################################################################

target_sources(
    app PRIVATE src/main.cpp src/logger/logger.cpp src/app/app.cpp src/cmclient/cmclient.cpp src/runner/runner.cpp
                src/storage/storage.cpp src/domain_bins.S
)

# ######################################################################################################################
# Versioning
# ######################################################################################################################

find_package(Git)

if(NOT GIT_FOUND)
    set(GIT_EXECUTABLE git)
endif()

set(CMAKE_MODULE_PATH ${PROJECT_SOURCE_DIR}/CMakeModules)

add_custom_target(
    version
    COMMAND
        ${CMAKE_COMMAND} -D GIT_EXECUTABLE=${GIT_EXECUTABLE} -D INPUT_FILE=${CMAKE_SOURCE_DIR}/src/version.hpp.in -D
        OUTPUT_FILE=${CMAKE_CURRENT_BINARY_DIR}/version.hpp -D GIT_SOURCE_DIR=${CMAKE_SOURCE_DIR} -P
        ${CMAKE_MODULE_PATH}/GenerateVersion.cmake
)

add_dependencies(app version)

# ######################################################################################################################
# External libs
# ######################################################################################################################

include(ExternalProject)

zephyr_get_include_directories_for_lang_as_string(CXX includes)
zephyr_get_system_include_directories_for_lang_as_string(CXX system_includes)
zephyr_get_compile_definitions_for_lang_as_string(CXX definitions)
zephyr_get_compile_options_for_lang_as_string(CXX options)

set(external_project_cxx_flags "${includes} ${system_includes} ${definitions} ${options}")

# ######################################################################################################################
# aos_core_lib_cpp
# ######################################################################################################################

set(aos_cxx_flags "${external_project_cxx_flags} -Wno-pedantic -Wno-error")

# Aos core configuration

if(NOT BOARD MATCHES "native_posix*")
    zephyr_compile_definitions(-DAOS_CONFIG_DEFAULT_THREAD_STACK_SIZE=1024)
endif()

set(AOSCORE_BUILD_DIR ${CMAKE_CURRENT_BINARY_DIR}/aoscore)

ExternalProject_Add(
    aoscore
    PREFIX ${AOSCORE_BUILD_DIR}
    CMAKE_ARGS -DCMAKE_INSTALL_PREFIX=${AOSCORE_BUILD_DIR} -DCMAKE_C_COMPILER=${CMAKE_C_COMPILER}
               -DCMAKE_CXX_COMPILER=${CMAKE_CXX_COMPILER} -DCMAKE_SYSTEM_NAME=${CMAKE_SYSTEM_NAME}
               -DCMAKE_SYSTEM_PROCESSOR=${CMAKE_SYSTEM_PROCESSOR} -DCMAKE_CXX_FLAGS=${aos_cxx_flags}
    SOURCE_DIR ${APPLICATION_SOURCE_DIR}/../aos_core_lib_cpp
    BUILD_BYPRODUCTS ${AOSCORE_BUILD_DIR}/lib/libaossmcpp.a ${AOSCORE_BUILD_DIR}/lib/libaosiamcpp.a
)

if(BOARD MATCHES "qemu")
    set(utils_scripts_dir ${CMAKE_CURRENT_SOURCE_DIR}/scripts)
    if(DTC)
        add_custom_target(
            fix_dtb
            DEPENDS ${ZEPHYR_FINAL_EXECUTABLE}
            COMMAND ${utils_scripts_dir}/fix_dtb.sh ${utils_scripts_dir}/gicv2.tmpl ${ZEPHYR_BINARY_DIR}/virt_gicv2.dtb
                    ${ZEPHYR_BINARY_DIR}/zephyr.bin
        )
        add_dependencies(run fix_dtb)
    else()
        message(WARNING "No dtc program")
    endif()
    set(BUILD_XEN 1)
#    set(XEN_VER 4.16)
    set(XEN_VER 4.17)
    if (BUILD_XEN)
        set(XEN_SRCDIR ${CMAKE_CURRENT_SOURCE_DIR}/../xen_${XEN_VER})
        if(XEN_VER VERSION_EQUAL 4.16)
            message(WARNING "Here is VER 4.16")
            set(XEN_BINDIR ${CMAKE_CURRENT_BINARY_DIR}/hyp)
        else()
            message(WARNING "Here is VER 4.17")
            set(XEN_BINDIR ${XEN_SRCDIR}/xen)
            set(XEN_BUILD_OPT O=${XEN_BINDIR})
        endif()

        ExternalProject_Add(
            hypervisor
            PREFIX ${XEN_BINDIR}
            SOURCE_DIR ${XEN_SRCDIR}/xen
            BINARY_DIR ${XEN_BINDIR}
            CONFIGURE_COMMAND ""
            BUILD_COMMAND ${MAKE} make -C ${XEN_SRCDIR}/xen ${XEN_BUILD_OPT}
                CONFIG_QEMU_XEN=y CONFIG_DEBUG=y XSM_ENABLE=y
                XEN_TARGET_ARCH=arm64 CROSS_COMPILE=aarch64-linux-gnu- HOSTCC=gcc
            INSTALL_COMMAND cp ${XEN_BINDIR}/xen ${ZEPHYR_BINARY_DIR}/xen
        )
    else()
        set(xen_srcdir ${CMAKE_CURRENT_SOURCE_DIR})
        set(xen_bindir ${CMAKE_CURRENT_SOURCE_DIR})

        ExternalProject_Add(
            hypervisor
            PREFIX ${xen_bindir}
            SOURCE_DIR ${xen_srcdir}
            BINARY_DIR ${xen_bindir}
            CONFIGURE_COMMAND ""
#        BUILD_COMMAND ${MAKE} make -C ${xen_srcdir}/xen O=${xen_bindir} CONFIG_QEMU_XEN=y CONFIG_DEBUG=y XSM_ENABLE=y
#                      XEN_TARGET_ARCH=arm64 CROSS_COMPILE=aarch64-linux-gnu- HOSTCC=gcc
#        INSTALL_COMMAND cp ${xen_bindir}/xen ${ZEPHYR_BINARY_DIR}/xen
            BUILD_COMMAND ""
            INSTALL_COMMAND cp ${xen_bindir}/xen ${ZEPHYR_BINARY_DIR}/xen
        )
    endif()
    add_dependencies(app hypervisor)
endif()
# aossm

file(MAKE_DIRECTORY ${AOSCORE_BUILD_DIR}/include)

add_library(aossm STATIC IMPORTED GLOBAL)

add_dependencies(aossm aoscore)

set_target_properties(aossm PROPERTIES IMPORTED_LOCATION ${AOSCORE_BUILD_DIR}/lib/libaossmcpp.a)
set_target_properties(aossm PROPERTIES INTERFACE_INCLUDE_DIRECTORIES ${AOSCORE_BUILD_DIR}/include)

target_link_libraries(app PUBLIC aossm)
```

## west.yml
```
#
# Copyright (C) 2023 Renesas Electronics Corporation.
# Copyright (C) 2023 EPAM Systems, Inc.
#
# SPDX-License-Identifier: Apache-2.0
#

# West YAML manifest for Zephyr as Xen Dom0

manifest:
  self:
    path: aos_core_zephyr

  remotes:
    - name: xen-troops
      url-base: https://github.com/xen-troops

    - name: aoscloud
      url-base: https://github.com/aoscloud

    - name: zephyr
      url-base: https://github.com/zephyrproject-rtos

    - name: amoi
      url-base: https://github.com/oleksiimoisieiev/

    - name: dsemenets
      url-base: https://github.com/dsemenets/
  projects:
    - name: zephyr
      remote: dsemenets
      revision: xtop
      west-commands: scripts/west-commands.yml

    - name: aos_core_lib_cpp
      remote: aoscloud
      revision: 7cdf7299ff704c6046c1d49eb20070b08f171912

    - name: zephyr-xenlib
      remote: dsemenets
      revision: xentop

    - name: littlefs
      remote: zephyr
      path: modules/fs/littlefs
      groups:
        - fs
      revision: ca583fd297ceb48bced3c2548600dc615d67af24
```

## prj.conf
```kconfig
# Enable C++

CONFIG_CPP=y
CONFIG_CPP_MAIN=y
CONFIG_STD_CPP14=y

# Enable logging

CONFIG_LOG=y
CONFIG_LOG_FUNC_NAME_PREFIX_ERR=n
CONFIG_LOG_FUNC_NAME_PREFIX_WRN=n
CONFIG_LOG_FUNC_NAME_PREFIX_INF=n
CONFIG_LOG_FUNC_NAME_PREFIX_DBG=n
CONFIG_LOG_DEFAULT_LEVEL=4

# Enable assert for debugging purposes
# TODO: remove for release
CONFIG_ASSERT=y

# Enable pthreads

CONFIG_PTHREAD_IPC=y
CONFIG_POSIX_API=y
CONFIG_MAX_PTHREAD_COUNT=8

CONFIG_MP_NUM_CPUS=1
CONFIG_XEN_STORE_SRV=y
CONFIG_XEN_DOMAIN_MANAGEMENT=y
CONFIG_XEN_SHELL=y
CONFIG_XRUN_SHELL_CMDS=y
CONFIG_XEN_LIBFDT=y
CONFIG_XRUN=y
CONFIG_JSON_LIBRARY=y
CONFIG_XSTAT=y
CONFIG_XSTAT_SHELL_CMDS=y
# CONFIG_DEBUG=y
```

## src/main.cpp
```c
/*
 * Copyright (C) 2023 Renesas Electronics Corporation.
 * Copyright (C) 2023 EPAM Systems, Inc.
 *
 * SPDX-License-Identifier: Apache-2.0
 */
#include <zephyr/sys/__assert.h>
#include <zephyr/sys/printk.h>

#include <aos/common/version.hpp>

#include "app/app.hpp"
#include "logger/logger.hpp"
#include "version.hpp"
#define DEBUG
#if defined(DEBUG)
extern "C" {
#include <zephyr/storage/flash_map.h>

#include <xen_dom_mgmt.h>
#include <xrun.h>
#include <domain.h>

struct xen_domain_cfg domd_cfg;

#define LFS_NAME_MAX 255
#define PARTITION_NODE \
	DT_NODELABEL(storage)

int lsdir(const char *path)
{
	int res;
	struct fs_dir_t dirp;
	static struct fs_dirent entry;

	if (!path) {
		printk("FAIL: Invalid input parameter");
		return -EINVAL;
	}

	fs_dir_t_init(&dirp);

	/* Verify fs_opendir() */
	res = fs_opendir(&dirp, path);
	if (res) {
		printk("FAIL: Error opening dir %s [%d]", path, res);
		return res;
	}

	printk("Listing dir %s ...", path);
	for (;;) {
		/* Verify fs_readdir() */
		res = fs_readdir(&dirp, &entry);

		/* entry.name[0] == 0 means end-of-dir */
		if (res || entry.name[0] == 0) {
			if (res < 0) {
				printk("FAIL: Error reading dir [%d]", res);
			}
			break;
		}

		if (entry.type == FS_DIR_ENTRY_DIR) {
			printk("[DIR ] %s", entry.name);
		} else {
			printk("[FILE] %s (size = %zu)",
					entry.name, entry.size);
		}
	}

	/* Verify fs_closedir() */
	fs_closedir(&dirp);

	return res;
}

int write_file(const char *path, const char *name,
	       char *buf, size_t size)
{
	struct fs_file_t file;
	int rc, ret;
	char fname[LFS_NAME_MAX];

	if (!path || !name || !buf) {
		printk("FAIL: Invalid input parameters");
		return -EINVAL;
	}

        rc = snprintf(fname, LFS_NAME_MAX, "%s/%s", path, name);
	if (rc <= 0) {
		printk("FAIL: Unable to form file path: %d", rc);
		return rc;
	}

	fs_file_t_init(&file);
	rc = fs_open(&file, fname, FS_O_CREATE | FS_O_WRITE);
	if (rc < 0) {
		printk("FAIL: open %s: %d", fname, rc);
		return rc;
	}

	rc = fs_write(&file, buf, size);
	if (rc < 0) {
		printk("FAIL: write %s: %d", fname, rc);
		goto out;
	}

	printk("%s write file size %lu: [wr:%d]", fname, size, rc);

 out:
	ret = fs_close(&file);
	if (ret < 0) {
		printk("FAIL: close %s: %d", fname, ret);
		return ret;
	}

	return (rc < 0 ? rc : 0);
}

static int littlefs_flash_erase(unsigned int id)
{
	const struct flash_area *pfa;
	int rc;

	rc = flash_area_open(id, &pfa);
	if (rc < 0) {
		printk("FAIL: unable to find flash area %u: %d\n",
			id, rc);
		return rc;
	}

	printk("Area %u at 0x%x on %s for %u bytes\n",
		   id, (unsigned int)pfa->fa_off, pfa->fa_dev->name,
		   (unsigned int)pfa->fa_size);

	flash_area_close(pfa);
	return rc;
}

#if DT_NODE_EXISTS(PARTITION_NODE)
FS_FSTAB_DECLARE_ENTRY(PARTITION_NODE);
#else /* PARTITION_NODE */
FS_LITTLEFS_DECLARE_DEFAULT_CONFIG(storage);
static struct fs_mount_t lfs_storage_mnt = {
	.type = FS_LITTLEFS,
	.fs_data = &storage,
	.storage_dev = (void *)FIXED_PARTITION_ID(storage_partition),
	.mnt_point = "/lfs",
};
#endif /* PARTITION_NODE */

	struct fs_mount_t *mp =
#if DT_NODE_EXISTS(PARTITION_NODE)
		&FS_FSTAB_ENTRY(PARTITION_NODE)
#else
		&lfs_storage_mnt
#endif
		;

static int littlefs_mount(struct fs_mount_t *mp)
{
	int rc;

	rc = littlefs_flash_erase((uintptr_t)mp->storage_dev);
	if (rc < 0) {
		return rc;
	}

	/* Do not mount if auto-mount has been enabled */
#if !DT_NODE_EXISTS(PARTITION_NODE) || \
	!(FSTAB_ENTRY_DT_MOUNT_FLAGS(PARTITION_NODE) & FS_MOUNT_FLAG_AUTOMOUNT)
	rc = fs_mount(mp);
	if (rc < 0) {
		printk("Mount id %" PRIuPTR " at %s: %d\n",
			(uintptr_t)mp->storage_dev, mp->mnt_point, rc);
		return rc;
	}
	printk("%s mount: %d\n", mp->mnt_point, rc);
#else
	printk("%s automounted\n", mp->mnt_point);
#endif

	return 0;
}

static int littlefs_umount(struct fs_mount_t *mp)
{
	int rc;

	/* Do not mount if auto-mount has been enabled */
#if !DT_NODE_EXISTS(PARTITION_NODE) ||									\
    !(FSTAB_ENTRY_DT_MOUNT_FLAGS(PARTITION_NODE) & FS_MOUNT_FLAG_AUTOMOUNT)
	rc = fs_umount(mp);
	if (rc < 0) {
		printk("Fail to umount id %" PRIuPTR " at %s: %d\n", (uintptr_t)mp->storage_dev,
				mp->mnt_point, rc);
		return rc;
	}
	printk("%s unmounted: %d\n", mp->mnt_point, rc);
#else
	printk("%s automounted, ignore\n", mp->mnt_point);
#endif

	return 0;
}

char json_msg[] = "{"
	"\"ociVersion\" : \"1.0.1\", "
	"\"vm\" : { "
		"\"hypervisor\": { "
			"\"path\": \"xen\", "
			"\"parameters\": [\"pvcalls=true\"] "
		"}, "
		"\"kernel\": { "
			"\"path\" : \"/lfs/unikernel.bin\", "
			"\"parameters\" : [ \"port=8124\", \"hello world\" ]"
		"}, "
		"\"hwconfig\": { "
			"\"devicetree\": \"/lfs/uni.dtb\" "
		"}, "
		"\"name\": \"DomU\""
	"} "
"}";

extern char __img_unikraft_start[];
extern char __img_unikraft_end[];
extern char __dtb_unikraft_start[];
extern char __dtb_unikraft_end[];

void init_root(void)
{
}

static void prepare_configs()
{
	int ret;

	init_root();

	ret = littlefs_mount(mp);
	if (ret) {
		printk("Unable to mount: %d\n", ret);
		return;
	}

	printk("dtb = %p\n", (void *)__dtb_unikraft_start);
	ret = write_file("/lfs", "config.json", json_msg, sizeof(json_msg));
	printk("Write config.json file ret = %d\n", ret);
	ret = write_file("/lfs", "unikernel.bin", __img_unikraft_start,
			__img_unikraft_end - __img_unikraft_start);
	printk("Write unikraft.bim file ret = %d\n", ret);
	ret = write_file("/lfs", "uni.dtb", __dtb_unikraft_start,
			__dtb_unikraft_end - __dtb_unikraft_start);
	printk("Write unikraft.dtb file ret = %d\n", ret);
	ret = lsdir("/lfs");
	printk("lsdir result = %d\n", ret);

	ret = littlefs_umount(mp);
	if (ret)
		printk("Error, unable to unmount %d\n", ret);
}

} /* extern "C" */
#endif /* CONFIG_DEBUG */

int main(void)
{
    printk("*** Aos zephyr application: %s ***\n", AOS_ZEPHYR_APP_VERSION);
    printk("*** Aos core library: %s ***\n", AOS_CORE_VERSION);

	prepare_configs();

    Logger::Init();

    auto& app = App::Get();

    auto err = app.Init();
    __ASSERT(err.IsNone(), "Error initializing application: %s", err.ToString());

    return 0;
}
```
